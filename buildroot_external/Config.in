## rootfs/external/Config.in
```kconfig
source "$BR2_EXTERNAL_OVM_PATH/package/conmon/Config.in"
source "$BR2_EXTERNAL_OVM_PATH/package/podman/Config.in"
source "$BR2_EXTERNAL_OVM_PATH/package/gvforwarder/Config.in"
```
